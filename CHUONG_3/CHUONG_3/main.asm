;
; CHUONG_3.asm
;
; Created: 2/8/2023 10:19:37 PM
; Author : thanh
;


; Replace with your application code
;SER R16
;OUT DDRA, R16
;OUT DDRB, R16
;LOOP: LDS R20, $100
;CPI R20, 5
;BRSH EQUA
;OUT PORTB, R20			//OUT PORT B
;RJMP LOOP
;EQUA: OUT PORTA, R20	//OUT PORT A
;RJMP LOOP

;.ORG 0X100
;LDS R20, $200
;LDI R21, 10		//DIV 10 FIRST
;CALL DIV8_8
;STS $201, R21
;LDI R21, 10		//DIV 10 SECOND
;CALL DIV8_8
;STS $202, R21
;STS $203, R20
;HERE: RJMP HERE

;DIV8_8:	PUSH R22
;		CLR R22
;LP1:	INC R22
;		SUB R20, R21
;		BRCC LP1
;		DEC R22
;		ADD R20, R21
;		MOV R21, R20
;		MOV R20, R22
;		POP R22
;		RET
;.ORG 0X00
;LDI R16,0X00
;OUT DDRA,R16
;LDI R16,0X7F
;OUT DDRB,R16
;LDI R16,0X0F
;OUT PORTA,R16
;LOOP:IN R17,PINA
;	 AND R17,R16
;	 CLR R18
;	 LDI ZL,LOW(MYDATA<<1)
;	 LDI ZH,HIGH(MYDATA<<1)
;	 ADD ZL, R17
;	 ADC ZH, R18
;	 LPM R18,Z
;	 OUT PORTB,R18
;	 RJMP LOOP
;FINAL: RJMP FINAL

;MYDATA: .DB ~0X40,~0X79,~0X24,~0X30,~0X19,~0X12,~0X02,~0X78,~0X00,~0X10;,0B1110111,0B1111100,0B0000110,0B1011110,0B1111001,0B1110001
// tính giá tr? c?a bi?u th?c Y=x2+2x+3 
// bi?t r?ng x là s? BCD nh?n ???c t? 4 bit th?p
// c?a PortA xu?t k?t qu? ra 3 led 7 ?o?n v?i s? hàng tr?m ra portB, hàng ch?c portC và hàng ??n v? portD
.ORG 0X00
CLR R16
OUT DDRA, R16
LDI R16, 0X7F
OUT PORTA, R16
OUT DDRB, R16
OUT DDRC, R16
OUT DDRD, R16

LOOP:
	IN R17, PINA
	ANDI R17, 0X0F
	CLR R20

	LDI ZH, HIGH(MYDATA<<1)
	LDI ZL, LOW(MYDATA<<1)
	ADD ZL, R17
	ADC ZH, R20

	LPM R20, Z
		CALL DIV_10
	MOV R18, R21
		CALL SEG_7
	OUT PORTD, R18
		CALL DIV_10
	MOV R18, R21
		CALL SEG_7
	OUT PORTC, R18
	MOV R18, R20
		CALL SEG_7
	OUT PORTB, R18
	RJMP LOOP


DIV_10:
	LDI R21, 10
	CLR R22
LP:	INC R22
	SUB R20, R21
	BRCC LP
	DEC R22
	ADD R21, R20
	MOV R20, R22
	CLR R22
RET

SEG_7:
	LDI ZH, HIGH(MYDATA1<<1)
	LDI ZL, LOW(MYDATA1<<1)
	ADD ZL, R18
	ADC ZH, R22
	LPM R18, Z
	RET

MYDATA: .DB 3,6,11,18,27,38,51,66,83,102
MYDATA1: .DB ~0X40,~0X79,~0X24,~0X30,~0X19,~0X12,~0X02,~0X78,~0X00,~0X10
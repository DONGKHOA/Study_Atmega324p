;
; BT_Chuong3_Luat.asm
;
; Created: 2/25/2023 3:13:10 PM
; Author : thanh
;


; Replace with your application code
; VD_2
.ORG 0
CLR R20
OUT DDRD, R20
SER R20
OUT PORTD, R20
OUT DDRB, R20

IN R21, PORTB
IN R20, PIND
ANDI R20, 0B00000011
CPI R20, 0
BRNE SS1
LDI R22, 1
EOR R21, R22
RJMP TTUC
SS1: CPI R20, 1
	BRNE SS2
	LDI R22, 2
	EOR R21, R22
	RJMP TTUC
SS2: CPI R20, 2
BRNE SS3




;VD_3
.ORG 0

CLR R20
OUT DDRA, R20
SER R20
OUT PORTA, R20
OUT DDRC, R20

LOOP: IN R16, PINA
CPI R16, $41
BRCS XOA
	CPI R16, $5B
	BRCS IN_HOA
	CPI R16, $61 // CPI R16, 'a'
	BRCS XOA
	CPI R16, $7B // CPI R16, 'z' + 1
	BRCC XOA


XUAT:
	OUT PORTC, R16
	RJMP LOOP

XOA:
	LDI R16, 0
	RJMP XUAT
IN_HOA:
	LDI R17, $20
	ADD R16, R17
	RJMP XUAT


;VD_4
; SUM_H = R21, SUM_L = R20
;LENGTH = R19
;POINTER = Z

.ORG 0
CLR R21
CLR R20
LDS R19, $1FF
LDI ZL, $00
LDI ZH, $02

LOOP:
	LD R16, Z+
	ADD R20, R16
	CLR R16
	ADC R21, R16
	DEC R19
	BRNE LOOP

STS $1FD, R20
STS $1FE, R21
ST: RJMP ST

;VD_4_1


; TIME DELAY = LOOP

;VD_5

.ORG 0
LDI R16, $80
OUT DDRB , R16
LOOP: SBI PORTB, 7
	LDI R20, 250
	LP: NOP
		DEC R20
		BRNE LP
	CBI PORTB, 7
	LDI R20, 250
	LP1: NOP
		DEC R20
		BRNE LP1
RJMP LOOP

;VD_6


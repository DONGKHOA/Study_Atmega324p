;
; EEPROM.asm
;
; Created: 2/26/2023 10:14:52 PM
; Author : thanh
;


; Replace with your application code
;Vi?t ch??ng trình th?c hi?n vi?c ghi chu?i ký t? t??ng ?ng v?i tên c?a SV vào EEPROM t?i ??a ch? 1FFH. Sau ?ó l?n l??t xu?t các ký t? ra portA b?t ??u t? ký t? ??u tiên


; ADDR -> R17:R18
; DATA -> R16

.ORG 0

; CONFIG PORTA OUTPUT
SER R16
OUT DDRA, R16

; WRITE DATA TO EEPROM

LDI R17, $FF
LDI R18, $1
LDI R16, 'K'
CALL EEPROM_WRITE

LDI R17, $00
LDI R18, $2
LDI R16, 'H'
CALL EEPROM_WRITE

LDI R17, $01
LDI R18, $2
LDI R16, 'O'
CALL EEPROM_WRITE

LDI R17, $02
LDI R18, $2
LDI R16, 'A'
CALL EEPROM_WRITE

; READ DATA FROM EEPROM

LDI R17, $FF
LDI R18, $1
CALL EEPROM_READ
OUT PORTA, R16

LDI R17, $00
LDI R18, $2
CALL EEPROM_READ
OUT PORTA, R16

LDI R17, $01
LDI R18, $2
CALL EEPROM_READ
OUT PORTA, R16

LDI R17, $02
LDI R18, $2
CALL EEPROM_READ
OUT PORTA, R16

; STOP PRORAMING AT HERE
HERE: RJMP HERE

EEPROM_WRITE:
	SBIC EECR, EEPE
	RJMP EEPROM_WRITE
	OUT EEARL, R17
	OUT EEARH, R18
	OUT EEDR, R16
	SBI EECR, EEMPE
	SBI EECR, EEPE
	CALL DELAY_5MS
	RET

EEPROM_READ:
	SBIC EECR, EEPE
	RJMP EEPROM_READ
	OUT EEARL, R17
	OUT EEARH, R18
	SBI EECR, EERE
	IN R16, EEDR
	RET


DELAY_5MS:
	LDI R20, 5
LP2: LDI R21, 250
LP1: NOP
	DEC R21
	BRNE LP1
	DEC R20
	BRNE LP2
RET